## Documentation/devicetree/bindings/bmc/npcm7xx-jtag-master.txt
```
Nuvoton NPCM7xx JTAG MASTER interface

Nuvoton BMC NPCM7xx JTAG Master is used for debugging host CPU or programming
CPLD device. The driver is implemented as an SPI device driver that enabling
the option to transfer JTAG data with the assistance of SPI HW.

Required properties for jtag_master node
- compatible		: "nuvoton,npcm750-jtag-master" for Poleg NPCM7XX.
- spi-max-frequency	: specify the max spi bus frequency.
- reg 				: always 0
- gcr-mfsel			: contains the MFSEL3 setting for PSPI
  + first cell		: GCR register offset (MFSEL3)
  + second cell		: register bitmask for PSPInSEL, where n = 1 or 2
  + third cell		: value in the PSPInSEL field
- tck-gpios			: specify the GPIO number of TCK pin
- tdi-gpios			: specify the GPIO number of TDI pin
- tdo-gpios			: specify the GPIO number of TDO pin
- tms-gpios			: specify the GPIO number of TMS pin

Example:
spi1: spi@201000 {
	...
	jtag_master {
		compatible = "nuvoton,npcm750-jtag-master";
		spi-max-frequency = <25000000>;
		reg = <0>;
		gcr-mfsel = <0x64 0x2000 0x2000>,  //pspi
			<0x64 0x2000 0x0>;  //gpio

		tck-gpios = <&gpio0 19 GPIO_ACTIVE_HIGH>;
		tdi-gpios = <&gpio0 18 GPIO_ACTIVE_HIGH>;
		tdo-gpios = <&gpio0 17 GPIO_ACTIVE_HIGH>;
		tms-gpios = <&gpio0 16 GPIO_ACTIVE_HIGH>;
		status = "okay";
	};
};
```

## Documentation/devicetree/bindings/clock/nuvoton,npcm750-clk.txt
```
* Nuvoton NPCM7XX Clock Controller

Nuvoton Poleg BMC NPCM7XX contain integrated clock
controller, which generates and supplies clock to all modules within the BMC.

Required Properties:

- compatible: should be one of following:
	- "nuvoton,npcm750-clk" : for clock controller of Nuvoton
	  Poleg BMC NPCM750

- reg: physical base address of the controller and length of memory mapped
  region.


- #clock-cells: should be 1.

All available clocks are defined as preprocessor macros in
dt-bindings/clock/nuvoton,npcm7xx-clock.h header and can beused in device tree
sources.

External clocks:

There are several clocks that are generated outside the BMC. All clocks are of
a known fixed value that cannot be chagned. Therefor these values are hard coded
inside the driver and registered on init.

The clock modules contains 4 PLL, 20 dividers and 11 muxes. All these settings
are set before Linux boot and are not to be altered by the Linux. This driver is
used only to read the values clocks, not to set them.

In addition to the clock driver, there are 3 external clocks suppling the
network, which are of fixed values, set on on the device tree, but not used by
 the clock module. Example can be found below.

Example: Clock controller node:

	clk: clock-controller@f0801000 {
		compatible = "nuvoton,npcm750-clk";
		#clock-cells = <1>;
		clock-controller;
		reg = <0xf0801000 0x1000>;
		status = "okay";
	};

Example: Required external clocks for network:

		/* external clock signal rg1refck, supplied by the phy */
		clk_rg1refck: clk_rg1refck {
			compatible = "fixed-clock";
			#clock-cells = <0>;
			clock-frequency = <125000000>;
			clock-output-names = "clk_rg1refck";
		};

		/* external clock signal rg2refck, supplied by the phy */
		clk_rg2refck: clk_rg2refck {
			compatible = "fixed-clock";
			#clock-cells = <0>;
			clock-frequency = <125000000>;
			clock-output-names = "clk_rg2refck";
		};

		clk_xin: clk_xin {
			compatible = "fixed-clock";
			#clock-cells = <0>;
			clock-frequency = <50000000>;
			clock-output-names = "clk_xin";
		};

Example: UART controller node that consumes the clock generated by the clock
  controller (refer to the standard clock bindings for information about
  "clocks" and "clock-names" properties):

	uart0: serial@e2900000 {
		compatible = "Nuvoton,s5pv210-uart";
		reg = <0xe2900000 0x400>;
		interrupt-parent = <&vic1>;
		interrupts = <10>;
		clock-names = "uart", "clk_uart_baud0",
				"clk_uart_baud1";
		clocks = <&clocks UART0>, <&clocks UART0>,
				<&clocks SCLK_UART0>;
	};
```

## Documentation/devicetree/bindings/misc/nuvoton,npcm-vdm.txt
```
NPCM SoC Vendor Defined Message via VDMA

Required properties:
- compatible  : "nuvoton,npcm750-vdm" for the NPCM7XX BMC.
- reg         : Specifies VDM physical base address and size of the registers.
				and VDMA physical base address and size of the registers.
- interrupts : contain VDMA interrupt.
				

Example:
vdma: vdma@e0800000 {
	compatible = "nuvoton,npcm750-vdm";
	reg = <0xe0800000 0x1000
		   0xf0822000 0x1000>;
	interrupts = <GIC_SPI 29 IRQ_TYPE_LEVEL_HIGH>;
};
```

## Documentation/devicetree/bindings/reset/nuvoton,npcm-reset.txt
```
Nuvoton NPCM Reset controller

In the NPCM Reset controller boot the USB PHY, USB host 
and USB device initialize.

Required properties:
- compatible : "nuvoton,npcm750-reset" for NPCM7XX BMC
- reg : specifies physical base address and size of the register.
- #reset-cells: must be set to 1

Example:
	rstc: rstc@f0801000 {
		compatible = "nuvoton,npcm750-reset";
		reg = <0xf0801000 0x70>;
		#reset-cells = <1>;
	};

Reset outputs:
 1  : FIU3 reset
 5  : UDC1 reset
 6  : EMC1 reset
 7  : UART 2-3 reset
 8  : UDC2 reset
 9  : PECI reset
 10 : AES reset
 11 : UART 0-1 reset
 12 : MC reset
 13 : SMB2 reset
 14 : SMB3 reset
 15 : SMB4 reset
 16 : SMB5 reset
 18 : PWM M0 reset
 19 : TIMER 0-4 reset
 20 : TIMER 5-9 reset
 21 : EMC2 reset
 22 : UDC4 reset
 23 : UDC5 reset
 24 : UDC6 reset
 25 : UDC3 reset
 26 : ADC reset
 28 : SMB6 reset
 29 : SMB7 reset
 30 : SMB0 reset
 31 : SMB1 reset
 32 : MFT0 reset
 33 : MFT1 reset
 34 : MFT2 reset
 35 : MFT3 reset
 36 : MFT4 reset
 37 : MFT5 reset
 38 : MFT6 reset
 39 : MFT7 reset
 40 : MMC reset
 41 : SDHC reset
 42 : GFX_SYS reset
 43 : AHB_PCIBRG reset
 44 : VDMA reset
 45 : ECE reset
 46 : VCD reset
 48 : OTP reset
 50 : SIOX1 reset
 51 : SIOX2 reset
 53 : 3DES reset
 54 : PSPI1 reset
 55 : PSPI2 reset
 57 : GMAC2 reset
 58 : USB host reset
 60 : GMAC1 reset
 63 : CP reset
 160: PWM M1 reset
 161: SMB12 reset
 162: SPIX reset
 163: SMB13 reset
 164: UDC0 reset
 165: UDC7 reset
 166: UDC8 reset
 167: UDC9 reset
 169: PCI mail box reset
 172: SMB14 reset
 173: SHA reset
 174: SEC ECC reset
 175: PCIe root complex reset
 176: Timer 10-14 reset
 177: RNG reset
 178: SMB15 reset
 179: SMB8 reset
 180: SMB9 reset
 181: SMB10 reset
 182: SMB11 reset
 183: ESPI reset
 183: USB PHY 1 reset
 184: USB PHY 2 reset
```

## Documentation/devicetree/bindings/serial/nuvoton,npcm-uart.txt
```
Nuvoton NPCM Universal Asynchronous Receiver/Transmitter (UART)

Required properties:
- compatible      : "nuvoton,npcm750-uart" for Poleg NPCM750.
- reg             : Offset and length of the register set for the device.
- interrupts      : Contain the UART interrupt with flags for falling edge.
- clocks          : phandle of UART reference clock.

Note: Each uart controller should have an alias correctly numbered
in "aliases" node.

Example:

aliases {
	serial0 = &serial0;
};

serial0: serial0@f0001000 {
	compatible = "nuvoton,npcm750-uart";
	reg = <0xf0001000 0x1000>;
	clocks = <&clk NPCM7XX_CLK_UART_CORE>;
	interrupts = <GIC_SPI 2 IRQ_TYPE_LEVEL_HIGH>;
	status = "disabled";
};
```

## arch/arm/mach-npcm/Kconfig
```kconfig
menuconfig ARCH_NPCM
	bool "Nuvoton NPCM Architecture"
	select ARCH_REQUIRE_GPIOLIB
	select USE_OF
	select PINCTRL
	select PINCTRL_NPCM7XX

if ARCH_NPCM

comment "NPCM Architecture type"

config ARCH_NPCM7XX
	depends on ARCH_NPCM && ARCH_MULTI_V7
	bool "Support for NPCM7xx BMC (Poleg)"
	select CACHE_L2X0
	select CPU_V7
	select ARM_GIC
	select HAVE_ARM_SCU
	select ARM_ERRATA_720789
	select ARM_ERRATA_754322
	select ARM_ERRATA_764369
	select ARM_ERRATA_794072
	select PL310_ERRATA_588369
	select PL310_ERRATA_727915
	select FIQ
	select CPU_USE_DOMAINS
	select GENERIC_CLOCKEVENTS
	select CLKDEV_LOOKUP
	select COMMON_CLK if OF
	select NPCM7XX_TIMER
	select MFD_SYSCON
	select MULTIPLEXER
	help
	  General support for NPCM7xx BMC (Poleg).

	  Nuvoton NPCM7xx BMC based on the Cortex A9.

choice
prompt "NPCM7xx BMC type"

config ARCH_NPCM750
	depends on ARCH_NPCM7XX
	default y if ARCH_NPCM7XX
	bool "Support for NPCM750 BMC"
	select SMP
	select SMP_ON_UP
	select HAVE_ARM_TWD if SMP
	select USB_EHCI_ROOT_HUB_TT
	select USB_ARCH_HAS_HCD
	select USB_ARCH_HAS_EHCI
	select USB_EHCI_HCD
	select USB_ARCH_HAS_OHCI
	select USB_OHCI_HCD
	select USB
	help
	  General support for NPCM750 BMC (Poleg).

config ARCH_NPCM730
	depends on ARCH_NPCM7XX
	bool "Support for NPCM730 BMC"
	select SMP
	select SMP_ON_UP
	select HAVE_ARM_TWD if SMP
	help
	  General support for NPCM730 BMC (Poleg).

endchoice

endif
```

## arch/arm/mach-npcmX50/Kconfig
```kconfig
if ARCH_NPCMX50

comment "NPCMX50 CPU type"

config CPU_WPCM450
	depends on ARCH_NPCMX50
	bool "Support for WPCM450 BMC CPU (Hermon)"
	select CPU_ARM926T
	help
	  Support for WPCM450 BMC CPU (Hermon).

config CPU_NPCM650
	depends on ARCH_NPCMX50
	bool "Support for NPCM650 BMC CPU (Yarkon)"
	select CPU_ARM926T    
	help
	  Support for NPCM650 BMC CPU (Yarkon).

config CPU_NPCM750
	depends on ARCH_NPCMX50
	bool "Support for NPCM750 BMC CPU (Poleg)"
	select CACHE_L2X0
	select CPU_V7
	select ARM_GIC
	select ARM_ERRATA_754322
	select ARM_ERRATA_764369
	select USB_EHCI_ROOT_HUB_TT
	select USB_ARCH_HAS_HCD
	select USB_ARCH_HAS_EHCI
	select USB_EHCI_HCD
	select USB_ARCH_HAS_OHCI
	select USB_OHCI_HCD
	select USB
	select FIQ
	select CPU_USE_DOMAINS	
	select COMMON_CLK if OF
#	select MIGHT_HAVE_CACHE_L2X0
	help
	  Support for NPCM750 BMC CPU (Poleg).

config CPU_NPCM750_SMP
	depends on ARCH_NPCMX50
	bool "Support for NPCM750 BMC CPU SMP (Poleg)"
	select HAVE_SMP
	select HAVE_ARM_SCU
	select ARM_ERRATA_458693
	select ARM_ERRATA_742231
	select ARM_ERRATA_794072
	select PL310_ERRATA_588369
	select PL310_ERRATA_727915
	select ARM_ERRATA_720789
	select DEBUG_SPINLOCK
	select GENERIC_CLOCKEVENTS
	select SMP
	select HAVE_ARM_TWD if SMP
	select HAVE_ARM_SCU if SMP
	select CLKDEV_LOOKUP
	select COMMON_CLK if OF
#	select MIGHT_HAVE_CACHE_L2X0
	help
	  Support for NPCM750 BMC CPU (Poleg).
      
comment "NPCMX50 Machines"

config MACH_WPCM450
	depends on ARCH_NPCMX50
	bool "Nuvoton WPCM450 Machine"
	select CPU_WPCM450
	help
	  Nuvoton WPCM450 Machine
      
config MACH_NPCM650
	depends on ARCH_NPCMX50
	bool "Nuvoton NPCM650 Machine"
	select CPU_NPCM650
	help
	  Nuvoton NPCM650 Machine

config MACH_NPCM750
	depends on ARCH_NPCMX50
	bool "Nuvoton NPCM750 Machine"
	select CPU_NPCM750
	help
	  Nuvoton NPCM750 Machine

config NPCMX50_PCI
	depends on ARCH_NPCMX50
	bool "Nuvoton NPCM750 PCI support"
	default n
	select PCI
	select PCI_MSI
	help
	  NPCM750 PCIe Root Complex support.

	  If unsure, say Y.
	  
endif
```

## drivers/net/ethernet/nuvoton/Kconfig
```kconfig
#
# Nuvoton network device configuration
#

config NET_VENDOR_NUVOTON
	bool "Nuvoton devices"
	default y
	depends on ARM && (ARCH_W90X900 || ARCH_NPCM7XX)
	---help---
	  If you have a network (Ethernet) card belonging to this class, say Y.

	  Note that the answer to this question doesn't directly affect the
	  kernel: saying N will just cause the configurator to skip all
	  the questions about Nuvoton cards. If you say Y, you will be asked
	  for your specific card in the following questions.

if NET_VENDOR_NUVOTON

config W90P910_ETH
	tristate "Nuvoton w90p910 Ethernet support"
	depends on ARM && ARCH_W90X900
	select PHYLIB
	select MII
	---help---
	  Say Y here if you want to use built-in Ethernet ports
	  on w90p910 processor.

config NPCM750_EMC_ETH
	bool "Nuvoton NPCM750 Ethernet EMC"
	depends on ARM && ARCH_NPCM7XX && ARCH_NPCM750
	select PHYLIB
	select MII
	---help---
	  Say Y here if you want to use built-in Ethernet MAC
	  on NPCM750 MCU.

config NPCM750_EMC_ETH_DEBUG
	bool "Nuvoton NPCM750 Ethernet EMC debug"
	depends on NPCM750_EMC_ETH
	---help---
	  Say Y here if you want debug info via /proc/driver/npcm750_emc.x

config NPCM750_EMC_ETH_DEBUG_EXT
	bool "Nuvoton NPCM750 Ethernet EMC extra debug"
	depends on NPCM750_EMC_ETH_DEBUG
	---help---
	  Say Y here if you want extra debug info via /proc/driver/npcm750_emc.x

endif # NET_VENDOR_NUVOTON
```

## drivers/pinctrl/nuvoton/Kconfig
```kconfig
config PINCTRL_NPCM7XX
	bool "Pinctrl driver for Nuvoton NPCM7XX"
	select GPIOLIB
	select GPIOLIB_IRQCHIP
	select PINMUX
	select PINCONF
	select GENERIC_PINCONF
	default ARCH_NPCM7XX
```
